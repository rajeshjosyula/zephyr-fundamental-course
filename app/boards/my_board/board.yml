## app/boards/my_board/board.yml
```yaml
board:
  name: my_board
  full_name: my Board
  vendor: st
  socs:
    - name: stm32f767xx
```

## app/boards/my_board/my_board_defconfig
```kconfig
# Enable MPU
CONFIG_ARM_MPU=y

# Enable HW stack protection
CONFIG_HW_STACK_PROTECTION=y

# Enable UART
CONFIG_SERIAL=y
CONFIG_UART_STM32=y

# Enable PrintK
CONFIG_PRINTK=y

# Console
CONFIG_CONSOLE=y
CONFIG_UART_CONSOLE=y

# Enable GPIO
CONFIG_GPIO=y
```

## dts/bindings/rajesh,driver.yaml
```yaml
description: My simple GPIO driver
compatible: "rajesh,driver"
include: base.yaml
```
